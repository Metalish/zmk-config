## config/west.yml
```yaml
manifest:
  remotes:
    - name: zmkfirmware
      url-base: https://github.com/zmkfirmware
  projects:
    - name: zmk
      remote: zmkfirmware
      #revision: main # Use this in general
      revision: refs/pull/3506/head  # This is for a specific fix
      import: app/west.yml
  self:
    path: config
```
